/dts-v1/;
/plugin/;

&{/} {
    compatible = "brcm,bcm2711";

    fragment@0 {
        target = <&i2c1>;
        __overlay__ {
            #address-cells = <1>;
            #size-cells = <0>;

            lcd@27 {
                compatible = "custom,i2c-lcd-2004a";
                reg = <0x27>;
            };
        };
    };
};
